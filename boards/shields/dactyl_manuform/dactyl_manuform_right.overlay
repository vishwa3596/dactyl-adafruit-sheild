#include "dactyl_manuform.dtsi"

&default_transform { // The matrix transform for this board is 5 columns over because the left half is 5 columns wide according to the matrix.
    col-offset = <6>;
};

&kscan0 {
    col-gpios
        = <&gpio0 20 GPIO_ACTIVE_HIGH>
        , <&gpio1 2 GPIO_ACTIVE_HIGH>
        , <&gpio0 24 GPIO_ACTIVE_HIGH>
        , <&gpio0 16 GPIO_ACTIVE_HIGH>
        , <&gpio0 14 GPIO_ACTIVE_HIGH>
        , <&gpio0 27 GPIO_ACTIVE_HIGH>
        ;
};
